## defconfig
```kconfig
# Components (official Bouffalo SDK)
CONFIG_FREERTOS=y
CONFIG_TLSF=y
CONFIG_CHERRYUSB=y
CONFIG_CHERRYUSB_OSAL=freertos
CONFIG_CHERRYUSB_HOST=y
CONFIG_CHERRYUSB_HOST_HID=y
CONFIG_CHERRYUSB_HOST_XBOX=y
CONFIG_CHERRYUSB_HOST_MSC=y
CONFIG_BSP_SDH_SD=y
CONFIG_BSP_SDH_SDCARD=y
CONFIG_FATFS=y
CONFIG_FATFS_USBH=y
CONFIG_FATFS_SDH_SDCARD=y
```
